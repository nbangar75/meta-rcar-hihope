## conf/layer.conf
```bitbake
# We have a conf and classes directory, add to BBPATH
BBPATH .= ":${LAYERDIR}"

# We have recipes-* directories, add to BBFILES
BBFILES += "${LAYERDIR}/recipes-*/*/*.bb \
            ${LAYERDIR}/recipes-*/*/*.bbappend"

BBFILE_COLLECTIONS += "meta-rcar-hihope"
BBFILE_PATTERN_meta-rcar-hihope = "^${LAYERDIR}/"
BBFILE_PRIORITY_meta-rcar-hihope = "6"

LAYERDEPENDS_meta-rcar-hihope = "core"
LAYERSERIES_COMPAT_meta-rcar-hihope = "dunfell"

# Device tree for M3
KERNEL_DEVICETREE_r8a7796_append = " \
    renesas/r8a77961-hihope-rzg2m.dtb \
    renesas/r8a77961-hihope-rzg2m-ex.dtb \
    renesas/r8a77961-hihope-rzg2m-ex-idk-1110wr.dtb \
    renesas/r8a77961-hihope-rzg2m-ex-mipi-2.1.dtb \
    renesas/r8a77961-hihope-rzg2m-ex-mipi-2.4.dtb \
"

DISTRO_FEATURES_append = " hihope_test_audio"
DISTRO_FEATURES_append = " hihope_test_wifibt"
DISTRO_FEATURES_append = " hihope_test_camera"
DISTRO_FEATURES_append = " hihope_test_msiof"
```
